## CMakeLists.txt
```
cmake_minimum_required(VERSION 3.20.0)

# Suppress warning about maybe-uninitialized from the uart_emul.c file from Zephyr
add_compile_options(-Wno-maybe-uninitialized)

find_package(Zephyr REQUIRED HINTS $ENV{ZEPHYR_BASE})
project(uart_thread_test)

# add location_module (the unit under test)
target_sources(app
    PRIVATE 
    ../../../app/src/modules/uart/uart_thread.c
    ../../../app/src/common/zbus_channels.c
)

zephyr_include_directories(${ZEPHYR_BASE}/subsys/testsuite/include)
zephyr_include_directories(${ZEPHYR_BASE}/include/zephyr/)
target_include_directories(app PRIVATE ../../../app/src/common)

target_link_options(app PRIVATE --whole-archive)
# Options that cannot be passed through Kconfig fragments
target_compile_definitions(app PRIVATE
	-DCONFIG_APP_UART_LOG_LEVEL=4
	-DCONFIG_APP_UART_THREAD_STACK_SIZE=1024
	-DCONFIG_APP_UART_WATCHDOG_TIMEOUT_SECONDS=10
	-DCONFIG_APP_UART_PIPE_READ_TIMEOUT_SECONDS=5
)

# add test file
target_sources(app PRIVATE src/test_uart_thread.c)
```

## Kconfig
```
# Config options for Button thread test
#
# SPDX-License-Identifier: LicenseRef-Nordic-5-Clause
#
source "Kconfig.zephyr"
```

## prj.conf
```kconfig
CONFIG_ZTEST=y

# Task Watchdog
CONFIG_TASK_WDT=y
CONFIG_TASK_WDT_CHANNELS=5
CONFIG_TASK_WDT_MIN_TIMEOUT=10000

# Configure Zbus
CONFIG_ZBUS=y
CONFIG_ZBUS_LOG_LEVEL_DBG=y

# Configure Emulation
CONFIG_EMUL=y
CONFIG_UART_EMUL=y

# Configure UART
CONFIG_SERIAL=y
CONFIG_UART_ASYNC_API=y

# Configure Logging
CONFIG_LOG=y
CONFIG_ASSERT=y
CONFIG_BOOT_BANNER=n
```

## native_sim.overlay
```dts
/*
 * Copyright (c) 2021 Nordic Semiconductor ASA
 * SPDX-License-Identifier: Apache-2.0
 */

/* This devicetree overlay file will be automatically picked by the Zephyr
 * build system when building the sample for the nrf52840dk board. It shows
 * how the example-application can be built on sample boards already provided
 * by Zephyr.
 */

/ {
    aliases {
		datauart = &euart0;
	};

	euart0: uart-emul0 {
		compatible = "zephyr,uart-emul";
		status = "okay";
		current-speed = <0>;
		rx-fifo-size = <256>;
		tx-fifo-size = <256>;
	};
};
```

## src/test_uart_thread.c
```c
#include <zephyr/irq_offload.h>
#include <zephyr/kernel.h>
#include <zephyr/logging/log.h>
#include <zephyr/zbus/zbus.h>
#include <zephyr/ztest.h>
#include <zephyr/drivers/serial/uart_emul.h>

#include "zbus_channels.h"

LOG_MODULE_REGISTER( test_uart_thread, LOG_LEVEL_DBG );

static void after_test( void * );
static void test_listener_callback( const struct zbus_channel *chan );

ZBUS_LISTENER_DEFINE( test_lis, test_listener_callback );
ZBUS_CHAN_ADD_OBS( UART_CHAN, test_lis, 0 );

K_MSGQ_DEFINE( test_msgq, sizeof( struct uart_msg ), 10, 1 );

// Get UART configuration from the devicetree
#define UART_NODE DT_ALIAS( datauart )
#if !DT_NODE_HAS_STATUS_OKAY( UART_NODE )
#error "Unsupported board: sw0 devicetree alias is not defined"
#endif
static const struct device *uart_device = DEVICE_DT_GET( UART_NODE );

void after_test( void * )
{
    k_msgq_purge( &test_msgq );
}

void test_listener_callback( const struct zbus_channel *chan )
{
    const struct uart_msg *uart_message = zbus_chan_const_msg( chan );
    k_msgq_put( &test_msgq, uart_message, K_NO_WAIT );
}

ZTEST( integration, test_uart_rx_lump_data )
{
    // Emulate UART Rx Data
    uint8_t test_data[UART_MESSAGE_BUFFER_SIZE] = { 0 };
    memset( test_data, 0x69, sizeof( test_data ) );
    uart_emul_put_rx_data( uart_device, test_data, sizeof( test_data ) );

    // Wait for the button event
    struct uart_msg uart_message = { 0 };
    k_msgq_get( &test_msgq, &uart_message, K_FOREVER );
    zassert_mem_equal( test_data, uart_message.data, uart_message.len, "Rx data does not match test data." );
}

ZTEST( integration, test_uart_rx_frag_data )
{
    // Emulate UART Rx Data
    uint8_t test_data[UART_MESSAGE_BUFFER_SIZE] = { 0 };
    memset( test_data, 0x69, sizeof( test_data ) );

    for( unsigned int i = 0; i < sizeof( test_data ); i++ )
    {
        uart_emul_put_rx_data( uart_device, &test_data[i], 1 );
    }

    // Wait for the button event
    struct uart_msg uart_message = { 0 };
    k_msgq_get( &test_msgq, &uart_message, K_FOREVER );
    zassert_mem_equal( test_data, uart_message.data, uart_message.len, "Rx data does not match test data." );
}

ZTEST_SUITE( integration, NULL, NULL, NULL, after_test, NULL );
```
