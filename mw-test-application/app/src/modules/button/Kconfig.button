## mw-test-application/app/src/modules/button/Kconfig.button
```kconfig
menu "Button"

config APP_BUTTON_THREAD_STACK_SIZE
	int "Thread stack size"
	default 1024

config APP_BUTTON_MSGQ_SIZE
	int "Message queue size"
	default 5

config APP_BUTTON_WATCHDOG_TIMEOUT_SECONDS
	int "Watchdog timeout seconds"
	default 120

config APP_BUTTON_MSGQ_TIMEOUT_SECONDS
	int "Wait for message timeout seconds"
	default 60

# https://docs.zephyrproject.org/latest/services/logging/index.html#logging-in-a-module
module = APP_BUTTON
module-str = Button
source "subsys/logging/Kconfig.template.log_config"

endmenu # Button
```

## mw-test-application/app/src/modules/led/Kconfig.led
```kconfig
menu "LED"

config APP_LED_THREAD_STACK_SIZE
	int "Thread stack size"
	default 256

config APP_LED_MSGQ_SIZE
	int "Message queue size"
	default 5

config APP_LED_WATCHDOG_TIMEOUT_SECONDS
	int "Watchdog timeout seconds"
	default 120

config APP_LED_MSGQ_TIMEOUT_SECONDS
	int "Wait for message timeout seconds"
	default 60

# https://docs.zephyrproject.org/latest/services/logging/index.html#logging-in-a-module
module = APP_LED
module-str = LED
source "subsys/logging/Kconfig.template.log_config"

endmenu # LED
```

## mw-test-application/app/src/modules/uart/Kconfig.uart
```kconfig
menu "UART"

config APP_UART_THREAD_STACK_SIZE
	int "Thread stack size"
	default 4096

config APP_UART_WATCHDOG_TIMEOUT_SECONDS
	int "Watchdog timeout seconds"
	default 120

config APP_UART_PIPE_READ_TIMEOUT_SECONDS
	int "Wait for pipe read timeout seconds"
	default 60

# https://docs.zephyrproject.org/latest/services/logging/index.html#logging-in-a-module
module = APP_UART
module-str = UART
source "subsys/logging/Kconfig.template.log_config"

endmenu # UART
```

## mw-test-application/tests/app/button_thread/testcase.yaml
```yaml
tests:
  button_thread.tester:
    sysbuild: true
    platform_allow:
      - native_sim
    integration_platforms:
      - native_sim
    tags:
      - button_thread
      - sysbuild
```

## mw-test-application/tests/app/led_thread/testcase.yaml
```yaml
tests:
  led_thread.tester:
    sysbuild: true
    platform_allow:
      - native_sim
    integration_platforms:
      - native_sim
    tags:
      - led_thread
      - sysbuild
```

## mw-test-application/west.yml
```yaml
# Copyright (c) 2021 Nordic Semiconductor ASA
# SPDX-License-Identifier: Apache-2.0

manifest:
  self:
    west-commands: scripts/west-commands.yml

  remotes:
    - name: zephyrproject-rtos
      url-base: https://github.com/zephyrproject-rtos
    # - name: nrf
    #   url-base: https://github.com/nrfconnect
  projects:
    # - name: sdk-nrf
    #   # update once nrf-sdk is forked to sidmodi-mw
    #   remote: nrf
    #   path: nrf
    #   revision: v2.9.0
    #   import:
    #     path-prefix: external
    #     name-allowlist:
    #       - zephyr
    #       - mcuboot
    #       - cmsis      # required by the ARM port
    #       - hal_nordic # required by the custom_plank board (Nordic based)
    #       - hal_stm32  # required by the nucleo_f302r8 board (STM32 based)

    - name: zephyr
      remote: zephyrproject-rtos
      revision: main
      path: zephyr
      import:
        path-prefix: external
        # By using name-allowlist we can clone only the modules that are
        # strictly needed by the application.
        name-allowlist:
          - mcuboot
          - cmsis      # required by the ARM port
          - hal_nordic # required by the custom_plank board (Nordic based)
          - hal_stm32  # required by the nucleo_f302r8 board (STM32 based)
```
